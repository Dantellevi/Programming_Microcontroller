#include "USART.h"
#include <xc.h>


/*
 =====================Функция инициализации USART-интерфейса===========
 */
char USART_Init(long int baud)
{
    unsigned int x;
    x=((_XTAL_FREQ - baud*64)/(baud*64));
    if(x>255)                                       //If High Baud Rage Required
  {
    x = (_XTAL_FREQ - baud*16)/(baud*16); //SPBRG for High Baud Rate
    BRGH = 1;                                     //Setting High Baud Rate
  }
  if(x<256)
  {
     SPBRG = x; //write Data registr speed
     SYNC=0;    //отк. синхронный режим(устанавливаем ассинхронный режим))
     SPEN=1;    //вкл. разрешение работы порта
     TRISC7=1;  //пин RxD устанавливаем на вход
     TRISC6=0;  //пин TxD устанав. на выход
     CREN=1;    //устанавливаем бит на непрерывный прием данных
     TXEN = 1;  //вкл. передачу данных
     return 1;
  }
    return 0;
    
}

//==============================================================================

/*
 ==============================Функция передачи одного символа==================
 */
void Transmit_char(char data)
{
    while(!TRMT);       //ожидаем флага разрешения передачи
    TXREG=data;
    
    
}
//==============================================================================

char UART_TX_Empty(void)
{
    return TRMT;
}

//==============================================================================


/*
 ================================Передача строки================================
 */

void Usart_PrintString(char *Text)
{
    char i=0;
    for(i=0;Text[i]!='\0';i++)
    {
        Transmit_char(Text[i]);
    }
    
}

//==============================================================================

/*
 ==============================Прием символа====================================
 * 
 */
char USART_Read(void)
{
    while(!RCIF);
    return RCREG;
}
//==============================================================================


/*
 ==================================Прием строки=================================
 */
void UART_Read_Text(char *Output, unsigned int length)
{
  unsigned int i;
  for(int i=0;i<length;i++)
  Output[i] = USART_Read();
}
//==============================================================================

/*
 =====================Проверка на готовность приема============================
 */
char UART_Data_Ready()
{
  return RCIF;
}
