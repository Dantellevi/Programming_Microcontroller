#include "Usartlib.h"

/*
 ==========================================Функция инициализации USART======================
 * Принимаемые параметры:
 *              baud-скорость передачи в бодах
 */
void Usart_Init(long int baud)
{
    /*
      unsigned int x;
    x=((_XTAL_FREQ - baud*64)/(baud*64));
    if(x>255)                                       //If High Baud Rage Required
  {
    x = (_XTAL_FREQ - baud*16)/(baud*16); //SPBRG for High Baud Rate
    BRGH = 1;                                     //Setting High Baud Rate
  }
     * 
     * if(x<256)
    {
     *   }
     */
   
    
        SPBRG = baud; //write Data registr speed
        SYNC=0;    //отк. синхронный режим(устанавливаем ассинхронный режим))
        SPEN=1;    //вкл. разрешение работы порта
        TRISC7=1;  //пин RxD устанавливаем на вход
        TRISC6=0;  //пин TxD устанав. на выход
        CREN=1;    //устанавливаем бит на непрерывный прием данных
        TXEN = 1;  //вкл. передачу данных 
  
}



/*
 ==============================Функция передачи одного символа==================
 * Принимаемые параметры:
 * data-передаваемый байт по порту
 */
void Transmit_char(char data)
{
    while(!TRMT);       //ожидаем флага разрешения передачи
    TXREG=data;
    
    
}


//================================Функция проверки завершения передачи==============================================

char UART_TX_Empty(void)
{
    return TRMT;
}



/*
 ============================Функция передачи строки=========================
 Принимаемые параметры:
 * *Text-указатель на строку для передачи
 */
void Usart_TransmitString(char *Text)
{
    char i=0;
    for(i=0;Text[i]!='\0';i++)
    {
        Transmit_char(Text[i]);
    }
}


/*
 ==============================Функция перехода на новую строку===============
 */
void GoNewLine(void)
{
    Transmit_char(0x0D);
    Transmit_char(0x0A);
}



/*
 ==============================Прием символа====================================
 *  Возвращаемое значение: данные из буффера USART
 */
char USART_Read(void)
{
    while(!RCIF);
    return RCREG;
}

/*
 ==================================Функция приема строки=================================
 
 *          Принимаемые значения:
 *                  *OutPut- буффер для сохранения даннных из порта
 *                  length-значение длинны принимаемого сообщения
 * 
 */
void UART_Read_Text(char *Output, unsigned int length)
{
  unsigned int i;
  for(int i=0;i<length;i++)
  Output[i] = USART_Read();
}



/*
 =====================Проверка на готовность приема============================
 
 *          Возвращаемое значение:
 *              флаг о том что прием разрешен
 */
char UART_Data_Ready(void)
{
  return RCIF;
}